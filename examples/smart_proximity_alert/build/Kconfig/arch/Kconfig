## examples/smart_proximity_alert/build/Kconfig/arch/Kconfig
```kconfig
# Load Zephyr Arch Kconfig descriptions.
osource "/home/alberto/zephyrproject/zephyr/arch/x86/Kconfig"
osource "/home/alberto/zephyrproject/zephyr/arch/xtensa/Kconfig"
osource "/home/alberto/zephyrproject/zephyr/arch/sparc/Kconfig"
osource "/home/alberto/zephyrproject/zephyr/arch/riscv/Kconfig"
osource "/home/alberto/zephyrproject/zephyr/arch/posix/Kconfig"
osource "/home/alberto/zephyrproject/zephyr/arch/nios2/Kconfig"
osource "/home/alberto/zephyrproject/zephyr/arch/mips/Kconfig"
osource "/home/alberto/zephyrproject/zephyr/arch/arm64/Kconfig"
osource "/home/alberto/zephyrproject/zephyr/arch/arm/Kconfig"
osource "/home/alberto/zephyrproject/zephyr/arch/arc/Kconfig"
```

## examples/smart_proximity_alert/build/Kconfig/boards/Kconfig.decawave_dwm3001cdk
```kconfig
# Load board Kconfig descriptions.
osource "/home/alberto/zephyrproject/zephyr/boards/qorvo/decawave_dwm3001cdk/Kconfig.decawave_dwm3001cdk"
```

## examples/smart_proximity_alert/build/Kconfig/boards/Kconfig.defconfig
```kconfig
# Load Zephyr board defconfig descriptions.
osource "/home/alberto/zephyrproject/zephyr/boards/qorvo/decawave_dwm3001cdk/Kconfig.defconfig"
```

## examples/smart_proximity_alert/build/Kconfig/boards/Kconfig.sysbuild
```kconfig
# Load Sysbuild board Kconfig descriptions.
osource "/home/alberto/zephyrproject/zephyr/boards/qorvo/decawave_dwm3001cdk/Kconfig.sysbuild"
```

## examples/smart_proximity_alert/build/Kconfig/soc/Kconfig.defconfig
```kconfig
# Load Zephyr SoC defconfig descriptions.
osource "/home/alberto/zephyrproject/zephyr/soc/xlnx/zynqmp/Kconfig.defconfig"
osource "/home/alberto/zephyrproject/zephyr/soc/xlnx/zynq7000/Kconfig.defconfig"
osource "/home/alberto/zephyrproject/zephyr/soc/xlnx/versalnet/Kconfig.defconfig"
osource "/home/alberto/zephyrproject/zephyr/soc/xen/Kconfig.defconfig"
osource "/home/alberto/zephyrproject/zephyr/soc/wch/ch32v/Kconfig.defconfig"
osource "/home/alberto/zephyrproject/zephyr/soc/ti/simplelink/Kconfig.defconfig"
osource "/home/alberto/zephyrproject/zephyr/soc/ti/lm3s6965/Kconfig.defconfig"
osource "/home/alberto/zephyrproject/zephyr/soc/ti/k3/Kconfig.defconfig"
osource "/home/alberto/zephyrproject/zephyr/soc/telink/tlsr/Kconfig.defconfig"
osource "/home/alberto/zephyrproject/zephyr/soc/starfive/jh71xx/Kconfig.defconfig"
osource "/home/alberto/zephyrproject/zephyr/soc/st/stm32/Kconfig.defconfig"
osource "/home/alberto/zephyrproject/zephyr/soc/snps/qemu_arc/Kconfig.defconfig"
osource "/home/alberto/zephyrproject/zephyr/soc/snps/nsim/arc_v/Kconfig.defconfig"
osource "/home/alberto/zephyrproject/zephyr/soc/snps/nsim/arc_classic/Kconfig.defconfig"
osource "/home/alberto/zephyrproject/zephyr/soc/snps/hsdk4xd/Kconfig.defconfig"
osource "/home/alberto/zephyrproject/zephyr/soc/snps/hsdk/Kconfig.defconfig"
osource "/home/alberto/zephyrproject/zephyr/soc/snps/emsk/Kconfig.defconfig"
osource "/home/alberto/zephyrproject/zephyr/soc/snps/emsdp/Kconfig.defconfig"
osource "/home/alberto/zephyrproject/zephyr/soc/snps/arc_iot/Kconfig.defconfig"
osource "/home/alberto/zephyrproject/zephyr/soc/silabs/Kconfig.defconfig"
osource "/home/alberto/zephyrproject/zephyr/soc/sifive/sifive_freedom/Kconfig.defconfig"
osource "/home/alberto/zephyrproject/zephyr/soc/sensry/Kconfig.defconfig"
osource "/home/alberto/zephyrproject/zephyr/soc/rockchip/Kconfig.defconfig"
osource "/home/alberto/zephyrproject/zephyr/soc/renode/riscv_virtual/Kconfig.defconfig"
osource "/home/alberto/zephyrproject/zephyr/soc/renode/cortex_r8_virtual/Kconfig.defconfig"
osource "/home/alberto/zephyrproject/zephyr/soc/renesas/smartbond/Kconfig.defconfig"
osource "/home/alberto/zephyrproject/zephyr/soc/renesas/rz/Kconfig.defconfig"
osource "/home/alberto/zephyrproject/zephyr/soc/renesas/rcar/Kconfig.defconfig"
osource "/home/alberto/zephyrproject/zephyr/soc/renesas/ra/Kconfig.defconfig"
osource "/home/alberto/zephyrproject/zephyr/soc/realtek/ec/Kconfig.defconfig"
osource "/home/alberto/zephyrproject/zephyr/soc/raspberrypi/rpi_pico/Kconfig.defconfig"
osource "/home/alberto/zephyrproject/zephyr/soc/quicklogic/eos_s3/Kconfig.defconfig"
osource "/home/alberto/zephyrproject/zephyr/soc/qemu/virt_riscv/Kconfig.defconfig"
osource "/home/alberto/zephyrproject/zephyr/soc/qemu/malta/Kconfig.defconfig"
osource "/home/alberto/zephyrproject/zephyr/soc/openisa/rv32m1/Kconfig.defconfig"
osource "/home/alberto/zephyrproject/zephyr/soc/openhwgroup/cva6/Kconfig.defconfig"
osource "/home/alberto/zephyrproject/zephyr/soc/oct/osd32mp15x/Kconfig.defconfig"
osource "/home/alberto/zephyrproject/zephyr/soc/nxp/s32/Kconfig.defconfig"
osource "/home/alberto/zephyrproject/zephyr/soc/nxp/rw/Kconfig.defconfig"
osource "/home/alberto/zephyrproject/zephyr/soc/nxp/mcx/Kconfig.defconfig"
osource "/home/alberto/zephyrproject/zephyr/soc/nxp/lpc/Kconfig.defconfig"
osource "/home/alberto/zephyrproject/zephyr/soc/nxp/layerscape/Kconfig.defconfig"
osource "/home/alberto/zephyrproject/zephyr/soc/nxp/kinetis/Kconfig.defconfig"
osource "/home/alberto/zephyrproject/zephyr/soc/nxp/imxrt/Kconfig.defconfig"
osource "/home/alberto/zephyrproject/zephyr/soc/nxp/imx/Kconfig.defconfig"
osource "/home/alberto/zephyrproject/zephyr/soc/nuvoton/numicro/Kconfig.defconfig"
osource "/home/alberto/zephyrproject/zephyr/soc/nuvoton/numaker/Kconfig.defconfig"
osource "/home/alberto/zephyrproject/zephyr/soc/nuvoton/npcx/Kconfig.defconfig"
osource "/home/alberto/zephyrproject/zephyr/soc/nuvoton/npcm/Kconfig.defconfig"
osource "/home/alberto/zephyrproject/zephyr/soc/nordic/Kconfig.defconfig"
osource "/home/alberto/zephyrproject/zephyr/soc/neorv32/Kconfig.defconfig"
osource "/home/alberto/zephyrproject/zephyr/soc/native/inf_clock/Kconfig.defconfig"
osource "/home/alberto/zephyrproject/zephyr/soc/microchip/miv/Kconfig.defconfig"
osource "/home/alberto/zephyrproject/zephyr/soc/microchip/mec/Kconfig.defconfig"
osource "/home/alberto/zephyrproject/zephyr/soc/mediatek/mt8xxx/Kconfig.defconfig"
osource "/home/alberto/zephyrproject/zephyr/soc/lowrisc/opentitan/Kconfig.defconfig"
osource "/home/alberto/zephyrproject/zephyr/soc/litex/litex_vexriscv/Kconfig.defconfig"
osource "/home/alberto/zephyrproject/zephyr/soc/ite/ec/Kconfig.defconfig"
osource "/home/alberto/zephyrproject/zephyr/soc/intel/raptor_lake/Kconfig.defconfig"
osource "/home/alberto/zephyrproject/zephyr/soc/intel/lakemont/Kconfig.defconfig"
osource "/home/alberto/zephyrproject/zephyr/soc/intel/intel_socfpga_std/Kconfig.defconfig"
osource "/home/alberto/zephyrproject/zephyr/soc/intel/intel_socfpga/Kconfig.defconfig"
osource "/home/alberto/zephyrproject/zephyr/soc/intel/intel_niosv/Kconfig.defconfig"
osource "/home/alberto/zephyrproject/zephyr/soc/intel/intel_ish/Kconfig.defconfig"
osource "/home/alberto/zephyrproject/zephyr/soc/intel/intel_adsp/Kconfig.defconfig"
osource "/home/alberto/zephyrproject/zephyr/soc/intel/elkhart_lake/Kconfig.defconfig"
osource "/home/alberto/zephyrproject/zephyr/soc/intel/atom/Kconfig.defconfig"
osource "/home/alberto/zephyrproject/zephyr/soc/intel/apollo_lake/Kconfig.defconfig"
osource "/home/alberto/zephyrproject/zephyr/soc/intel/alder_lake/Kconfig.defconfig"
osource "/home/alberto/zephyrproject/zephyr/soc/infineon/cat3/Kconfig.defconfig"
osource "/home/alberto/zephyrproject/zephyr/soc/infineon/cat1b/Kconfig.defconfig"
osource "/home/alberto/zephyrproject/zephyr/soc/infineon/cat1a/Kconfig.defconfig"
osource "/home/alberto/zephyrproject/zephyr/soc/gd/gd32/Kconfig.defconfig"
osource "/home/alberto/zephyrproject/zephyr/soc/gaisler/leon3/Kconfig.defconfig"
osource "/home/alberto/zephyrproject/zephyr/soc/gaisler/gr716a/Kconfig.defconfig"
osource "/home/alberto/zephyrproject/zephyr/soc/espressif/Kconfig.defconfig"
osource "/home/alberto/zephyrproject/zephyr/soc/ene/kb1200/Kconfig.defconfig"
osource "/home/alberto/zephyrproject/zephyr/soc/efinix/sapphire/Kconfig.defconfig"
osource "/home/alberto/zephyrproject/zephyr/soc/cdns/xtensa_sample_controller/Kconfig.defconfig"
osource "/home/alberto/zephyrproject/zephyr/soc/cdns/sample_controller32/Kconfig.defconfig"
osource "/home/alberto/zephyrproject/zephyr/soc/cdns/dc233c/Kconfig.defconfig"
osource "/home/alberto/zephyrproject/zephyr/soc/brcm/bcmvk/Kconfig.defconfig"
osource "/home/alberto/zephyrproject/zephyr/soc/brcm/bcm2712/Kconfig.defconfig"
osource "/home/alberto/zephyrproject/zephyr/soc/brcm/bcm2711/Kconfig.defconfig"
osource "/home/alberto/zephyrproject/zephyr/soc/bflb/Kconfig.defconfig"
osource "/home/alberto/zephyrproject/zephyr/soc/atmel/sam0/Kconfig.defconfig"
osource "/home/alberto/zephyrproject/zephyr/soc/atmel/sam/Kconfig.defconfig"
osource "/home/alberto/zephyrproject/zephyr/soc/aspeed/Kconfig.defconfig"
osource "/home/alberto/zephyrproject/zephyr/soc/arm/Kconfig.defconfig"
osource "/home/alberto/zephyrproject/zephyr/soc/arm/beetle/Kconfig.defconfig"
osource "/home/alberto/zephyrproject/zephyr/soc/antmicro/myra/Kconfig.defconfig"
osource "/home/alberto/zephyrproject/zephyr/soc/andestech/Kconfig.defconfig"
osource "/home/alberto/zephyrproject/zephyr/soc/amd/acp_6_0/Kconfig.defconfig"
osource "/home/alberto/zephyrproject/zephyr/soc/ambiq/Kconfig.defconfig"
osource "/home/alberto/zephyrproject/zephyr/soc/altr/zephyr_nios2f/Kconfig.defconfig"
osource "/home/alberto/zephyrproject/zephyr/soc/altr/qemu_nios2/Kconfig.defconfig"
osource "/home/alberto/zephyrproject/zephyr/soc/adi/max32/Kconfig.defconfig"
```
